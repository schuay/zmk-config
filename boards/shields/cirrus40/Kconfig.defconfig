## boards/shields/cirrus40/Kconfig.defconfig
```kconfig
if SHIELD_CIRRUS40LEFT

config ZMK_KEYBOARD_NAME
  default "cirrus40"

config ZMK_SPLIT_ROLE_CENTRAL
  default y

endif

if SHIELD_CIRRUS40LEFT || SHIELD_CIRRUS40RIGHT

config ZMK_SPLIT
    default y

endif
```

## boards/shields/cirrus40/Kconfig.shield
```kconfig
config SHIELD_CIRRUS40LEFT
    def_bool $(shields_list_contains,cirrus40_left)

config SHIELD_CIRRUS40RIGHT
    def_bool $(shields_list_contains,cirrus40_right)
```

## boards/shields/keyb40/Kconfig.defconfig
```kconfig
if SHIELD_KEYB40

config BOARD
  default "nice_nano_v2"

if SHIELD_KEYB40_LEFT

config ZMK_KEYBOARD_NAME
  default "Keyb40"

config ZMK_SPLIT_ROLE_CENTRAL
    default y

endif
endif
```

## boards/shields/keyb40/Kconfig.shield
```kconfig
config SHIELD_KEYB40_LEFT
    def_bool $(shields_list_contains,keyb40_left)

config SHIELD_KEYB40_RIGHT
    def_bool $(shields_list_contains,keyb40_right)
```
